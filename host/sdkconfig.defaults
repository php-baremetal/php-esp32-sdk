## host/sdkconfig.defaults
```kconfig
CONFIG_ESP_MAIN_TASK_STACK_SIZE=32768
CONFIG_FATFS_LFN_HEAP=y
CONFIG_FATFS_MAX_LFN=255
CONFIG_ESP_TASK_WDT_TIMEOUT_S=60
CONFIG_FREERTOS_HZ=1000
CONFIG_FATFS_SECTOR_4096=y
CONFIG_ESP_TASK_WDT_CHECK_IDLE_TASK_CPU1=n
```
